# STM32F334x register map
File version: 1.1
Registers are 32-bit, read-write, reset 0x0 unless marked. A register's access mark holds for its fields unless they carry their own. Offsets are from the block's base; lines under a group give offsets from that group; [hi:lo] are bit positions; {n}, {i} and the like mark numbered series; 'fields as' and 'values as' point back to an identical list; <NAME> marks a mode.

## Memory map
0x40000000 TIM2 size 0x400 — General purpose timer
0x40000400 TIM3 size 0x400
0x40001000 TIM6 size 0x400 — Basic timers
0x40001400 TIM7 size 0x400
0x40002800 RTC size 0x400 — Real-time clock
0x40002C00 WWDG size 0x400 — Window watchdog
0x40003000 IWDG size 0x400 — Independent watchdog
0x40004400 USART2 size 0x400
0x40004800 USART3 size 0x400
0x40005400 I2C1 size 0x400 — Inter-integrated circuit
0x40006400 CAN size 0x400 — Controller area network
0x40007000 PWR size 0x400 — Power control
0x40007400 DAC1 size 0x400 — Digital-to-analog converter 1
0x40009800 DAC2 size 0x400
0x40010000 SYSCFG size 0x19 — System configuration controller
0x4001001C COMP size 0x19 — Comparator
0x40010038 OPAMP size 0x3C8 — Operational amplifier
0x40010400 EXTI size 0x400 — External interrupt/event controller
0x40012C00 TIM1 size 0x400 — Advanced timer
0x40013000 SPI1 size 0x400 — Serial peripheral interface/Inter-IC sound
0x40013800 USART1 size 0x400 — Universal synchronous asynchronous receiver transmitter
0x40014000 TIM15 size 0x400 — General purpose timers
0x40014400 TIM16 size 0x400 — General-purpose-timers
0x40014800 TIM17 size 0x400 — General purpose timer
0x40017400 HRTIM_Master size 0x80 — High Resolution Timer: Master Timers
0x40017480 HRTIM_TIMA size 0x80 — High Resolution Timer: TIMA
0x40017500 HRTIM_TIMB size 0x80 — High Resolution Timer: TIMB
0x40017580 HRTIM_TIMC size 0x80 — High Resolution Timer: TIMC
0x40017600 HRTIM_TIMD size 0x80 — High Resolution Timer: TIMD
0x40017680 HRTIM_TIME size 0x80 — High Resolution Timer: TIME
0x40017780 HRTIM_Common size 0x80 — High Resolution Timer: Common functions
0x40020000 DMA1 size 0x400 — DMA controller 1
0x40021000 RCC size 0x400 — Reset and clock control
0x40022000 Flash size 0x400
0x40023000 CRC size 0x400 — cyclic redundancy check calculation unit
0x40024000 TSC size 0x400 — Touch sensing controller
0x48000000 GPIOA size 0x400 — General-purpose I/Os
0x48000400 GPIOB size 0x400 — General-purpose I/Os
0x48000800 GPIOC size 0x400
0x48000C00 GPIOD size 0x400
0x48001400 GPIOF size 0x400
0x50000000 ADC1 size 0x100 — Analog-to-Digital Converter
0x50000100 ADC2 size 0x100
0x50000300 ADC1_2 size 0xD — Analog-to-Digital Converter
0xE000E000 NVIC size 0x1001 — Nested Vectored Interrupt Controller
0xE000ED88 FPU size 0x200 — Floting point unit
0xE0042000 DBGMCU size 0x400 — Debug support

## Interrupts
0 WWDG — Window Watchdog interrupt
1 PVD (PWR) — PVD through EXTI line detection interrupt
2 TAMP_STAMP (EXTI) — Tamper and TimeStamp interrupts
3 RTC_WKUP (RTC) — RTC Wakeup interrupt through the EXTI line
4 FLASH (Flash) — Flash global interrupt
5 RCC — RCC global interrupt
6 EXTI0 (EXTI) — EXTI Line0 interrupt
7 EXTI1 (EXTI) — EXTI Line3 interrupt
8 EXTI2_TSC (TSC, EXTI) — EXTI Line2 and Touch sensing interrupts
9 EXTI3 (EXTI) — EXTI Line3 interrupt
10 EXTI4 (EXTI) — EXTI Line4 interrupt
11 DMA1_CH1 (DMA1) — DMA1 channel 1 interrupt
12 DMA1_CH2 (DMA1) — DMA1 channel 2 interrupt
13 DMA1_CH3 (DMA1) — DMA1 channel 3 interrupt
14 DMA1_CH4 (DMA1) — DMA1 channel 4 interrupt
15 DMA1_CH5 (DMA1) — DMA1 channel 5 interrupt
16 DMA1_CH6 (DMA1) — DMA1 channel 6 interrupt
17 DMA1_CH7 (DMA1) — DMA1 channel 7interrupt
18 ADC1_2 (ADC1, ADC2, ADC1_2) — ADC1 and ADC2 global interrupt
19 USB_HP_CAN_TX (CAN) — USB High Priority/CAN_TX interrupts
20 USB_LP_CAN_RX0 (CAN) — USB Low Priority/CAN_RX0 interrupts
21 CAN_RX1 (CAN) — CAN_RX1 interrupt
22 CAN_SCE (CAN) — CAN_SCE interrupt
23 EXTI9_5 (EXTI) — EXTI Line5 to Line9 interrupts
24 TIM1_BRK_TIM15 (TIM15) — TIM1 Break/TIM15 global interruts
25 TIM1_UP_TIM16 (TIM16) — TIM1 Update/TIM16 global interrupts
26 TIM1_TRG_COM_TIM17 (TIM17) — TIM1 trigger and commutation/TIM17 interrupts
27 TIM1_CC (TIM1) — TIM1 capture compare interrupt
28 TIM2 — TIM2 global interrupt
29 TIM3 — TIM3 global interrupt
31 I2C1_EV_EXTI23 (EXTI, I2C1) — I2C1 event interrupt and EXTI Line23 interrupt
32 I2C1_ER (I2C1) — I2C1 error interrupt
35 SPI1 — SPI1 global interrupt
37 USART1_EXTI25 (USART1, EXTI) — USART1 global interrupt and EXTI Line 25 interrupt
38 USART2_EXTI26 (USART2, EXTI) — USART2 global interrupt and EXTI Line 26 interrupt
39 USART3_EXTI28 (USART3, EXTI) — USART3 global interrupt and EXTI Line 28 interrupt
40 EXTI15_10 (EXTI) — EXTI Line15 to Line10 interrupts
41 RTCAlarm (RTC) — RTC alarm interrupt
52 UART4_EXTI34 (EXTI) — UART4 global and EXTI Line 34 interrupts
53 UART5_EXTI35 (EXTI) — UART5 global and EXTI Line 35 interrupts
54 TIM6_DACUNDER (TIM6, DAC1, DAC2) — TIM6 global and DAC12 underrun interrupts
55 TIM7 — TIM7 global interrupt
64 COMP123 (COMP) — COMP1 & COMP2 & COMP3 interrupts combined with EXTI Lines 21, 22 and 29 interrupts
65 COMP456 (COMP) — COMP4 & COMP5 & COMP6 interrupts combined with EXTI Lines 30, 31 and 32 interrupts
66 COMP7 (COMP) — COMP7 interrupt combined with EXTI Line 33 interrupt
76 USB_WKUP_EXTI (EXTI) — USB wakeup from Suspend and EXTI Line 18
81 FPU — Floating point interrupt
